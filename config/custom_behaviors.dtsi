
/ {
    behaviors {
        ht_tp: hold_tap_tap_preferred {
            compatible = "zmk,behavior-hold-tap";
            label = "HT_TP";
            #binding-cells = <2>;
            tapping-term-ms = <200>; // Default ZMK value
            flavor = "tap-preferred";
        };

        mod_tp: mod_tap_tap_preferred {
            compatible = "zmk,behavior-mod-tap"; // Use mod-tap compatible
            label = "MOD_TP";
            #binding-cells = <2>;
            tapping-term-ms = <200>; // Default ZMK value
            flavor = "tap-preferred";
        };
    };
};
