## config/west.yml
```yaml
manifest:
  defaults:
    revision: v0.3
  remotes:
    - name: zmkfirmware
      url-base: https://github.com/zmkfirmware
    - name: urob
      url-base: https://github.com/urob
  projects:
    - name: zmk
      remote: zmkfirmware
      revision: main
      import: app/west.yml
    - name: zmk-nodefree-config
      remote: urob
      revision: main
    - name: eyelash_corne
      url: https://github.com/a741725193/zmk-new_corne
      revision: main
  self:
    path: config
```
